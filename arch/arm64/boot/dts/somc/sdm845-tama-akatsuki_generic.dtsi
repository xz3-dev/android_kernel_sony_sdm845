/* arch/arm64/boot/dts/somc/sdm845-tama-akatsuki_generic.dtsi
 *
 * This program is free software; you can redistribute it and/or modify
 * it under the terms of the GNU General Public License version 2 and
 * only version 2 as published by the Free Software Foundation.
 *
 * This program is distributed in the hope that it will be useful,
 * but WITHOUT ANY WARRANTY; without even the implied warranty of
 * MERCHANTABILITY or FITNESS FOR A PARTICULAR PURPOSE.  See the
 * GNU General Public License for more details.
 */

#include "sdm845-tama-akatsuki_common.dtsi"

&soc {
};

/* SoftBank 801SO: Sony CXD224x + Rohm BD7602 instead of the global NXP PN553 */
#include "somc-tama-nfc_carillon-801so.dtsi"
